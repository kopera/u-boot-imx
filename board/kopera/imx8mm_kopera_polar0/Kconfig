## board/kopera/imx8mm_kopera_polar0/Kconfig
```kconfig
if TARGET_IMX8MM_KOPERA_POLAR0

config SYS_BOARD
	default "imx8mm_kopera_polar0"

config SYS_VENDOR
	default "kopera"

config SYS_CONFIG_NAME
	default "imx8mm_kopera_polar0"

source "board/freescale/common/Kconfig"

endif
```

## board/kopera/imx8mm_kopera_polar1/Kconfig
```kconfig
if TARGET_IMX8MM_KOPERA_POLAR1

config SYS_BOARD
	default "imx8mm_kopera_polar1"

config SYS_VENDOR
	default "kopera"

config SYS_CONFIG_NAME
	default "imx8mm_kopera_polar1"

source "board/freescale/common/Kconfig"

endif
```

## board/kopera/imx8mq_kopera_polar0/Kconfig
```kconfig
if TARGET_IMX8MQ_KOPERA_POLAR0

config SYS_BOARD
	default "imx8mq_kopera_polar0"

config SYS_VENDOR
	default "kopera"

config SYS_CONFIG_NAME
	default "imx8mq_kopera_polar0"

source "board/freescale/common/Kconfig"

endif
```

## configs/imx8mm_kopera_polar0_defconfig
```kconfig
CONFIG_ARM=y
CONFIG_ARCH_IMX8M=y
CONFIG_SYS_TEXT_BASE=0x40200000
CONFIG_SYS_MALLOC_F_LEN=0x2000
CONFIG_TARGET_IMX8MM_KOPERA_POLAR0=y
CONFIG_SPL_MMC_SUPPORT=y
CONFIG_DEFAULT_DEVICE_TREE="fsl-imx8mm-kopera-polar0"
CONFIG_FIT=y
CONFIG_SPL_LOAD_FIT=y
CONFIG_SYS_EXTRA_OPTIONS="IMX_CONFIG=arch/arm/mach-imx/spl_sd.cfg"
CONFIG_BOOTDELAY=1
CONFIG_DEFAULT_FDT_FILE="fsl-imx8mm-kopera-polar0.dtb"
CONFIG_ARCH_MISC_INIT=y
CONFIG_SPL=y
CONFIG_SPL_BOARD_INIT=y
CONFIG_SPL_USB_HOST_SUPPORT=y
CONFIG_SPL_USB_SDP_SUPPORT=y
CONFIG_HUSH_PARSER=y
CONFIG_CMD_MEMTEST=y
CONFIG_CMD_GPIO=y
CONFIG_CMD_I2C=y
CONFIG_CMD_CACHE=y
CONFIG_CMD_REGULATOR=y
CONFIG_CMD_FAT=y
CONFIG_CMD_EXT4=y
CONFIG_CMD_EXT4_WRITE=y
CONFIG_CMD_FS_GENERIC=y
CONFIG_DOS_PARTITION=y
CONFIG_EFI_PARTITION=y
CONFIG_OF_CONTROL=y
CONFIG_ENV_IS_IN_MMC=y
CONFIG_NET_RANDOM_ETHADDR=y
CONFIG_DM_GPIO=y
CONFIG_SYS_I2C_MXC=y
CONFIG_DM_MMC=y
CONFIG_DM_ETH=y
CONFIG_PINCTRL=y
CONFIG_PINCTRL_IMX8M=y
CONFIG_DM_REGULATOR=y
CONFIG_DM_REGULATOR_FIXED=y
CONFIG_DM_REGULATOR_GPIO=y
CONFIG_DM_THERMAL=y
CONFIG_NXP_TMU=y
CONFIG_USB=y
CONFIG_DM_USB=y
CONFIG_USB_XHCI_HCD=y
CONFIG_USB_XHCI_DWC3=y
CONFIG_SDP_LOADADDR=0x40400000
```
